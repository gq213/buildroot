## configs/8mp_defconfig
```kconfig
BR2_aarch64=y
BR2_ARM_FPU_VFPV3=y

BR2_DL_DIR="$(TOPDIR)/../dl"

BR2_OPTIMIZE_2=y

BR2_TOOLCHAIN_EXTERNAL=y
BR2_TOOLCHAIN_EXTERNAL_CUSTOM=y
BR2_TOOLCHAIN_EXTERNAL_PATH="$(TOPDIR)/../toolchain/arm-gnu-toolchain-12.3.rel1-x86_64-aarch64-none-linux-gnu"
BR2_TOOLCHAIN_EXTERNAL_CUSTOM_PREFIX="aarch64-none-linux-gnu"
BR2_TOOLCHAIN_EXTERNAL_GCC_12=y
BR2_TOOLCHAIN_EXTERNAL_HEADERS_4_20=y
BR2_TOOLCHAIN_EXTERNAL_CUSTOM_GLIBC=y
# BR2_TOOLCHAIN_EXTERNAL_INET_RPC is not set
BR2_TOOLCHAIN_EXTERNAL_CXX=y
BR2_TOOLCHAIN_EXTERNAL_FORTRAN=y
BR2_TOOLCHAIN_EXTERNAL_OPENMP=y

BR2_ROOTFS_DEVICE_CREATION_DYNAMIC_MDEV=y
BR2_TARGET_GENERIC_GETTY=n
BR2_TARGET_GENERIC_REMOUNT_ROOTFS_RW=n

BR2_TARGET_TZ_INFO=y
BR2_TARGET_TZ_ZONELIST="default"
BR2_TARGET_LOCALTIME="Asia/Shanghai"

BR2_ROOTFS_OVERLAY="board/8mp/fs-overlay"
BR2_ROOTFS_POST_BUILD_SCRIPT="board/8mp/post-build.sh"
BR2_PACKAGE_BUSYBOX_CONFIG="board/8mp/busybox.config"

BR2_TARGET_ROOTFS_CPIO=y
BR2_TARGET_ROOTFS_SQUASHFS=y
BR2_TARGET_ROOTFS_SQUASHFS4_LZ4=y

BR2_PACKAGE_WPA_SUPPLICANT=y
BR2_PACKAGE_WPA_SUPPLICANT_CLI=y

BR2_PACKAGE_WIRELESS_TOOLS=y
BR2_PACKAGE_IW=y
BR2_PACKAGE_IPERF3=y

BR2_PACKAGE_ALSA_UTILS=y
BR2_PACKAGE_ALSA_UTILS_AMIXER=y
BR2_PACKAGE_ALSA_UTILS_APLAY=y

BR2_PACKAGE_DOSFSTOOLS=y
BR2_PACKAGE_DOSFSTOOLS_FSCK_FAT=y
BR2_PACKAGE_DOSFSTOOLS_MKFS_FAT=y

BR2_PACKAGE_E2FSPROGS=y
BR2_PACKAGE_E2FSPROGS_FSCK=y
BR2_PACKAGE_E2FSPROGS_RESIZE2FS=y

BR2_PACKAGE_GPTFDISK=y

BR2_PACKAGE_CAN_UTILS=y
BR2_PACKAGE_IPROUTE2=y
BR2_PACKAGE_LMBENCH=y
BR2_PACKAGE_MEMTESTER=y
BR2_PACKAGE_BC=y
BR2_PACKAGE_STRESS=y

BR2_PACKAGE_LIBAIO=y
BR2_PACKAGE_LIBNFS=y
BR2_PACKAGE_LIBISCSI=y
BR2_PACKAGE_NUMACTL=y
BR2_PACKAGE_ZLIB=y
BR2_PACKAGE_FIO=y
```
